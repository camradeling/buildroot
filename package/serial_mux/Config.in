## package/serial_mux/Config.in
```kconfig
config BR2_PACKAGE_SERIAL_MUX
	bool "serial_mux"
	help
	  Serial port multiplexer. Allows multiple clients to share
	  a single serial port via Unix domain sockets.

if BR2_PACKAGE_SERIAL_MUX

config BR2_PACKAGE_SERIAL_MUX_ENABLE_ISP
	bool "Enable serial_mux@isp service"
	default y
	help
	  Enable the ISP serial mux instance at boot.

config BR2_PACKAGE_SERIAL_MUX_ENABLE_MCU
	bool "Enable serial_mux@mcu service"
	default y
	help
	  Enable the MCU serial mux instance at boot.

config BR2_PACKAGE_SERIAL_MUX_ENABLE_DUT2
	bool "Enable serial_mux@dut2 service"
	help
	  Enable the DUT2 ISP serial mux instance at boot.

	  Off by default: the instance needs a [dut2] section in
	  /etc/serial_mux.ini, which only the testbot4 device overlay
	  ships. Without it serial_mux_run.sh exits with an error and
	  the unit ends up failed.

endif
```

## package/sstar-flash/Config.in
```kconfig
config BR2_PACKAGE_SSTAR_FLASH
	bool "sstar-flash"
	help
	  Linux tool for flashing SigmaStar SoCs over USB.
	  Uses SCSI Generic (SG_IO) to send vendor commands to the
	  SoC's ROM bootloader / U-Boot over USB Mass Storage.

	  The source repository is private: set SSTAR_FLASH_REPO_URL
	  (e.g. in the board .vars file) to its git URL.

if BR2_PACKAGE_SSTAR_FLASH

config BR2_PACKAGE_SSTAR_FLASH_UDEV_RULES
	bool "Install udev rules"
	default y
	help
	  Install udev rules granting unprivileged access to
	  SigmaStar USB boot devices (VID:PID 1b20:0300, 1a40:0201).

endif
```
