## board/customized/orangepi/testbot4_defconfig
```kconfig
BR2_aarch64=y
BR2_ARM_FPU_VFPV4=y
BR2_KERNEL_HEADERS_VERSION=y
BR2_DEFAULT_KERNEL_VERSION="6.7"
BR2_PACKAGE_HOST_LINUX_HEADERS_CUSTOM_6_7=y
BR2_TOOLCHAIN_BUILDROOT_CXX=y
BR2_PACKAGE_HOST_GDB=y
BR2_PACKAGE_HOST_GDB_TUI=y
BR2_PACKAGE_HOST_GDB_PYTHON3=y
BR2_WGET="wget --passive-ftp -nd -t 3"
BR2_OPTIMIZE_S=y
BR2_TARGET_GENERIC_HOSTNAME="orangepi"
BR2_TARGET_GENERIC_ISSUE="Welcome to Buildroot for the Orange Pi Zero 3 (testbot4)"
BR2_INIT_SYSTEMD=y
BR2_TARGET_GENERIC_ROOT_PASSWD="123"
BR2_SYSTEM_BIN_SH_BASH=y
BR2_SYSTEM_DHCP="eth0"
BR2_SYSTEM_DEFAULT_PATH="/bin:/sbin:/usr/bin:/usr/sbin"
BR2_ROOTFS_OVERLAY="board/customized/overlays/filesystems/system_v2 board/customized/overlays/services/usb_gadget board/customized/overlays/services/ssh-server board/customized/overlays/services/openvpn board/customized/overlays/devices/testbot4 board/customized/overlays/services/usbipd board/customized/overlays/services/hostapd_wlan0 board/customized/overlays/services/dnsmasq_wlan0 board/customized/overlays/services/wpa_supplicant_wlan1 board/customized/overlays/services/netpolicy board/customized/overlays/services/xray"
BR2_ROOTFS_POST_BUILD_SCRIPT="board/customized/scripts/before-fs-allscripts.sh"
BR2_ROOTFS_POST_FAKEROOT_SCRIPT="board/customized/scripts/after-preset-check.sh"
BR2_ROOTFS_POST_IMAGE_SCRIPT="board/customized/orangepi/genimage3.sh"
BR2_LINUX_KERNEL=y
BR2_LINUX_KERNEL_CUSTOM_VERSION=y
BR2_LINUX_KERNEL_CUSTOM_VERSION_VALUE="6.7"
BR2_LINUX_KERNEL_USE_CUSTOM_CONFIG=y
BR2_LINUX_KERNEL_CUSTOM_CONFIG_FILE="board/customized/orangepi/linux_zero3.config"
BR2_LINUX_KERNEL_DTS_SUPPORT=y
BR2_LINUX_KERNEL_CUSTOM_DTS_PATH="board/customized/orangepi/sun50i-h618-orangepi-zero3.dts"
BR2_LINUX_KERNEL_NEEDS_HOST_OPENSSL=y
BR2_PACKAGE_LINUX_TOOLS_CPUPOWER=y
BR2_PACKAGE_LINUX_TOOLS_PERF=y
BR2_PACKAGE_BZIP2=y
BR2_PACKAGE_XZ=y
BR2_PACKAGE_UCLIBC_NG_TEST=y
BR2_PACKAGE_LIBTOOL=y
BR2_PACKAGE_E2FSPROGS=y
BR2_PACKAGE_E2FSPROGS_FUSE2FS=y
BR2_PACKAGE_E2FSPROGS_RESIZE2FS=y
BR2_PACKAGE_GENEXT2FS=y
BR2_PACKAGE_MTD=y
BR2_PACKAGE_AIC8800=y
BR2_PACKAGE_ARMBIAN_FIRMWARE=y
BR2_PACKAGE_ARMBIAN_FIRMWARE_UWE5622=y
BR2_PACKAGE_I2C_TOOLS=y
BR2_PACKAGE_LINUXCONSOLETOOLS=y
BR2_PACKAGE_LINUXCONSOLETOOLS_JOYSTICK=y
BR2_PACKAGE_SERIAL_MUX=y
BR2_PACKAGE_SSTAR_FLASH=y
BR2_PACKAGE_UBOOT_BOOTCOUNT=y
BR2_PACKAGE_UWE5622_WIFI=y
BR2_PACKAGE_BLUEZ5_UTILS=y
BR2_PACKAGE_BLUEZ5_UTILS_TOOLS=y
BR2_PACKAGE_STLINK=y
BR2_PACKAGE_PERL=y
BR2_PACKAGE_PYTHON3=y
BR2_PACKAGE_PYTHON_PYLIBFDT=y
BR2_PACKAGE_LIBGCRYPT=y
BR2_PACKAGE_BERKELEYDB=y
BR2_PACKAGE_SQLITE=y
BR2_PACKAGE_SQLITE_STAT4=y
BR2_PACKAGE_SQLITE_ENABLE_COLUMN_METADATA=y
BR2_PACKAGE_SQLITE_ENABLE_FTS3=y
BR2_PACKAGE_SQLITE_ENABLE_JSON1=y
BR2_PACKAGE_FONTCONFIG=y
BR2_PACKAGE_LIBVPL=y
BR2_PACKAGE_DTC=y
BR2_PACKAGE_DTC_PROGRAMS=y
BR2_PACKAGE_LIBXKBCOMMON=y
BR2_PACKAGE_MTDEV=y
BR2_PACKAGE_MXML=y
BR2_PACKAGE_LIBCURL=y
BR2_PACKAGE_LIBCURL_CURL=y
BR2_PACKAGE_LIBMICROHTTPD=y
BR2_PACKAGE_LIBUPNP=y
BR2_PACKAGE_GLM=y
BR2_PACKAGE_LIBEV=y
BR2_PACKAGE_LIBEVDEV=y
BR2_PACKAGE_LIBSEPOL_POLICY_VERSION=32
BR2_PACKAGE_LIBFRIBIDI=y
BR2_PACKAGE_NCURSES_TARGET_PROGS=y
BR2_PACKAGE_PCRE=y
BR2_PACKAGE_PCRE_UCP=y
BR2_PACKAGE_BIND=y
BR2_PACKAGE_CONNTRACK_TOOLS=y
BR2_PACKAGE_DHCP=y
BR2_PACKAGE_DHCP_CLIENT=y
BR2_PACKAGE_DNSMASQ=y
BR2_PACKAGE_DNSMASQ_CONNTRACK=y
BR2_PACKAGE_HOSTAPD=y
BR2_PACKAGE_IFPLUGD=y
BR2_PACKAGE_IFTOP=y
BR2_PACKAGE_IFUPDOWN=y
BR2_PACKAGE_IPROUTE2=y
BR2_PACKAGE_IPTABLES=y
BR2_PACKAGE_IW=y
BR2_PACKAGE_LIGHTTPD=y
BR2_PACKAGE_NETCAT=y
BR2_PACKAGE_OPENSSH=y
BR2_PACKAGE_OPENVPN=y
BR2_PACKAGE_RPCBIND=y
BR2_PACKAGE_RSYNC=y
BR2_PACKAGE_TCPDUMP=y
BR2_PACKAGE_USBIP=y
BR2_PACKAGE_WHOIS=y
BR2_PACKAGE_WIRELESS_TOOLS=y
BR2_PACKAGE_WIRELESS_TOOLS_LIB=y
BR2_PACKAGE_WPA_SUPPLICANT=y
BR2_PACKAGE_WPA_SUPPLICANT_AP_SUPPORT=y
BR2_PACKAGE_WPA_SUPPLICANT_CLI=y
BR2_PACKAGE_WPA_SUPPLICANT_PASSPHRASE=y
BR2_PACKAGE_WPA_SUPPLICANT_DBUS=y
BR2_PACKAGE_XRAY=y
BR2_PACKAGE_CHECKPOLICY=y
BR2_PACKAGE_SEMODULE_UTILS=y
BR2_PACKAGE_BASH_COMPLETION=y
BR2_PACKAGE_INOTIFY_TOOLS=y
BR2_PACKAGE_SCREEN=y
BR2_PACKAGE_SUDO=y
BR2_PACKAGE_HTOP=y
BR2_PACKAGE_UTIL_LINUX_BINARIES=y
BR2_PACKAGE_UTIL_LINUX_LAST=y
BR2_PACKAGE_UTIL_LINUX_MOUNTPOINT=y
BR2_PACKAGE_UTIL_LINUX_NOLOGIN=y
BR2_PACKAGE_UTIL_LINUX_PARTX=y
BR2_PACKAGE_UTIL_LINUX_PIVOT_ROOT=y
BR2_PACKAGE_UTIL_LINUX_RFKILL=y
BR2_PACKAGE_NANO=y
BR2_PACKAGE_RTL88XX_SPECIAL=y
BR2_PACKAGE_MODBUSGW_GPIO=y
BR2_TARGET_ROOTFS_EXT2=y
BR2_TARGET_ROOTFS_EXT2_4=y
BR2_TARGET_ROOTFS_EXT2_SIZE="512M"
# BR2_TARGET_ROOTFS_TAR is not set
BR2_TARGET_ARM_TRUSTED_FIRMWARE=y
BR2_TARGET_ARM_TRUSTED_FIRMWARE_CUSTOM_VERSION=y
BR2_TARGET_ARM_TRUSTED_FIRMWARE_CUSTOM_VERSION_VALUE="v2.10"
BR2_TARGET_ARM_TRUSTED_FIRMWARE_PLATFORM="sun50i_h616"
BR2_TARGET_UBOOT=y
BR2_TARGET_UBOOT_BUILD_SYSTEM_KCONFIG=y
BR2_TARGET_UBOOT_CUSTOM_VERSION=y
BR2_TARGET_UBOOT_CUSTOM_VERSION_VALUE="2024.01"
BR2_TARGET_UBOOT_BOARD_DEFCONFIG="orangepi_zero3"
BR2_TARGET_UBOOT_NEEDS_DTC=y
BR2_TARGET_UBOOT_NEEDS_PYLIBFDT=y
BR2_TARGET_UBOOT_NEEDS_ATF_BL31=y
BR2_TARGET_UBOOT_SPL=y
BR2_TARGET_UBOOT_SPL_NAME="u-boot-sunxi-with-spl.bin"
BR2_PACKAGE_HOST_DOSFSTOOLS=y
BR2_PACKAGE_HOST_GENIMAGE=y
BR2_PACKAGE_HOST_GO=y
BR2_PACKAGE_HOST_MTOOLS=y
BR2_PACKAGE_HOST_PYTHON3=y
BR2_PACKAGE_HOST_QORIQ_RCW=y
BR2_PACKAGE_HOST_UBOOT_TOOLS=y
```

## package/aic8800/Config.in
```kconfig
comment "aic8800 needs a Linux kernel to be built"
	depends on !BR2_LINUX_KERNEL

config BR2_PACKAGE_AIC8800
	bool "aic8800"
	depends on BR2_LINUX_KERNEL
	help
	  AIC8800 USB WiFi driver (aic_load_fw + aic8800_fdrv kernel
	  modules) and firmware for AIC Semiconductor 8800-series chips.

	  Supports AIC8800, AIC8800D80, AIC8800DC and variants.

	  https://github.com/radxa-pkg/aic8800

if BR2_PACKAGE_AIC8800

config BR2_PACKAGE_AIC8800_BTUSB
	bool "Bluetooth support (aic_btusb)"
	help
	  Also build and install the aic_btusb kernel module for
	  Bluetooth over USB.

endif

config BR2_PACKAGE_HOST_AIC8800
	bool "host aic8800"
	help
	  Build aic8800 WiFi kernel modules (aic_load_fw + aic8800_fdrv)
	  for the host machine's running kernel, and install firmware.
	  Useful when the WiFi adapter is plugged into the dev machine.
```

## package/modbusgw/Config.in
```kconfig
config BR2_PACKAGE_MODBUSGW
    bool "modbusgw"
    depends on BR2_PACKAGE_MXML
    help
      Modbus Gateway utility
```

## package/modbusgw_gpio/Config.in
```kconfig
config BR2_PACKAGE_MODBUSGW_GPIO
    bool "modbusgw_gpio"
    depends on BR2_PACKAGE_MXML
    help
      Modbus TCP to GPIO gateway. Drives sysfs GPIOs from Modbus
      holding register writes. Replacement for modbusgw on boards
      with direct GPIO relay control (no UART/STM32).
```

## package/serial_mux/Config.in
```kconfig
config BR2_PACKAGE_SERIAL_MUX
	bool "serial_mux"
	help
	  Serial port multiplexer. Allows multiple clients to share
	  a single serial port via Unix domain sockets.

if BR2_PACKAGE_SERIAL_MUX

config BR2_PACKAGE_SERIAL_MUX_ENABLE_ISP
	bool "Enable serial_mux@isp service"
	default y
	help
	  Enable the ISP serial mux instance at boot.

config BR2_PACKAGE_SERIAL_MUX_ENABLE_MCU
	bool "Enable serial_mux@mcu service"
	default y
	help
	  Enable the MCU serial mux instance at boot.

config BR2_PACKAGE_SERIAL_MUX_ENABLE_SOLANA
	bool "Enable serial_mux@solana service"
	help
	  Enable the Solana ISP serial mux instance at boot.

	  Off by default: the instance needs a [solana] section in
	  /etc/serial_mux.ini, which only the testbot4 device overlay
	  ships. Without it serial_mux_run.sh exits with an error and
	  the unit ends up failed.

endif
```

## package/sstar-flash/Config.in
```kconfig
config BR2_PACKAGE_SSTAR_FLASH
	bool "sstar-flash"
	help
	  Linux tool for flashing SigmaStar SoCs over USB.
	  Uses SCSI Generic (SG_IO) to send vendor commands to the
	  SoC's ROM bootloader / U-Boot over USB Mass Storage.

	  https://github.com/vdenisov-c-arlo/LoryUSBTool

if BR2_PACKAGE_SSTAR_FLASH

config BR2_PACKAGE_SSTAR_FLASH_UDEV_RULES
	bool "Install udev rules"
	default y
	help
	  Install udev rules granting unprivileged access to
	  SigmaStar USB boot devices (VID:PID 1b20:0300, 1a40:0201).

endif
```

## package/usbip/Config.in
```kconfig
config BR2_PACKAGE_USBIP
    bool "usbip"
    select BR2_PACKAGE_LIBGLIB2
    select BR2_PACKAGE_LIBSYSFS
    depends on BR2_TOOLCHAIN_HAS_THREADS  # Требует поддержки потоков
    depends on BR2_LINUX_KERNEL  # Требует сборки ядра
    #depends on BR2_LINUX_KERNEL_VERSION_GTE_3_17  # Минимальная версия ядра
    help
      Tools for sharing USB devices over IP network.
      Requires Linux kernel >= 3.17 with USB/IP support enabled.

      Kernel config requirements:
      - CONFIG_USBIP_CORE
      - CONFIG_USBIP_HOST (for server)
      - CONFIG_USBIP_VHCI_HCD (for client)

comment "USB/IP requires Linux kernel >= 3.17 (current: $(BR2_LINUX_KERNEL_VERSION))"
    depends on BR2_LINUX_KERNEL_VERSION_LT_3_17
```

## package/uwe5622-wifi/Config.in
```kconfig
config BR2_PACKAGE_UWE5622_WIFI
	bool "uwe5622-wifi"
	depends on BR2_LINUX_KERNEL
	depends on BR2_aarch64
	help
	  Wireless and Bluetooth driver for Unisoc UWE5622 SDIO
	  WiFi/BT combo chip, found on OrangePi Zero3 and similar
	  Allwinner H616/H618 boards.

	  This builds three kernel modules:
	    - uwe5622_bsp_sdio (SDIO platform/boot)
	    - sprdwl_ng (WiFi, cfg80211-based)
	    - sprdbt_tty (Bluetooth over SDIO)

comment "uwe5622-wifi needs a Linux kernel to be built"
	depends on !BR2_LINUX_KERNEL
```

## package/xray/Config.in
```kconfig
config BR2_PACKAGE_XRAY
	bool "xray"
	depends on BR2_aarch64
	help
	  Xray-core, a network proxy platform speaking VLESS/REALITY,
	  VMess, Trojan, Shadowsocks and SOCKS, with a transparent
	  proxy (TPROXY) inbound.

	  This installs the official prebuilt, statically linked aarch64
	  binary from the upstream release, not a from-source build:
	  current xray-core needs a much newer Go toolchain than
	  Buildroot's host-go provides. Only the xray binary is
	  installed - the geoip.dat/geosite.dat databases in the release
	  archive are 30MB of routing data we do not use.

	  https://github.com/XTLS/Xray-core

comment "xray needs an aarch64 target"
	depends on !BR2_aarch64
```
